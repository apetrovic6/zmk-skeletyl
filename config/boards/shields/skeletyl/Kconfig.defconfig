## config/boards/shields/skeletyl/Kconfig.defconfig
```kconfig
# Copyright (c) 2020 The ZMK Contributors
# SPDX-License-Identifier: MIT

if SHIELD_SKELETYL_DONGLE

# Max 16 characters in keyboard name
config ZMK_KEYBOARD_NAME
    default "Skeletyl"

config ZMK_SPLIT_ROLE_CENTRAL
    default y

config ZMK_SPLIT
    default y

# Set this to the number of peripherals your dongle will have.
# For a unibody, this would be 1. If you have left and right halves, set it to 2, etc.
config ZMK_SPLIT_BLE_CENTRAL_PERIPHERALS
    default 2

# Set this to ZMK_SPLIT_BLE_CENTRAL_PERIPHERALS + your desired number of BT profiles (default is 5)
config BT_MAX_CONN
    default 5

# Set this to the same number as BT_MAX_CONN
config BT_MAX_PAIRED
    default 5

endif

if SHIELD_SKELETYL_LEFT

config ZMK_KEYBOARD_NAME
	default "Skeletyl"

config ZMK_SPLIT_BLE_ROLE_CENTRAL
	default n

endif

if SHIELD_SKELETYL_LEFT || SHIELD_SKELETYL_RIGHT

config ZMK_SPLIT
	default y

endif
```
